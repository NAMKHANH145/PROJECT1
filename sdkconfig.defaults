## sdkconfig.defaults
```kconfig
# === System & Performance ===
CONFIG_IDF_TARGET="esp32s3"
CONFIG_COMPILER_OPTIMIZATION_PERF=y
CONFIG_FREERTOS_HZ=1000
# Disable USB-JTAG to free up GPIO 9/10 for I2C
CONFIG_ESP_CONSOLE_USB_SERIAL_JTAG=n 

# === PSRAM (SPIRAM) Configuration ===
CONFIG_SPIRAM=y
CONFIG_SPIRAM_MODE_QUAD=y
CONFIG_SPIRAM_SPEED_80M=y
CONFIG_SPIRAM_USE_MALLOC=y
CONFIG_SPIRAM_MEMTEST=y

# === Partition Table ===
# Use custom partition table to allow large app size (3MB) for AI + BLE + LVGL
CONFIG_PARTITION_TABLE_CUSTOM=y
CONFIG_PARTITION_TABLE_CUSTOM_FILENAME="partitions.csv"
CONFIG_PARTITION_TABLE_FILENAME="partitions.csv"
CONFIG_ESPTOOLPY_FLASHSIZE_4MB=y

# === Bluetooth Configuration ===
CONFIG_BT_ENABLED=y
CONFIG_BT_MODE_BLE=y
CONFIG_BT_BLE_42_FEATURES_SUPPORTED=y
CONFIG_BT_BLE_50_FEATURES_SUPPORTED=y
CONFIG_BT_NIMBLE_ENABLED=n
CONFIG_BT_BLUEDROID_ENABLED=y
# Increase BT memory to prevent crashes
CONFIG_BT_BLE_DYNAMIC_ENV_MEMORY=y

# === LVGL Configuration ===
# Color depth 16-bit (RGB565)
CONFIG_LV_COLOR_DEPTH_16=y
CONFIG_LV_COLOR_16_SWAP=y
# Enable Fonts
CONFIG_LV_FONT_MONTSERRAT_14=y
CONFIG_LV_FONT_MONTSERRAT_20=y
CONFIG_LV_FONT_MONTSERRAT_28=y
# Enable FPS Monitor (Optional, good for debug)
# CONFIG_LV_USE_PERF_MONITOR=y

# === Common ESP-IDF Settings ===
# Main task stack size (increased for safety)
CONFIG_ESP_MAIN_TASK_STACK_SIZE=8192
# Watchdog timeout increased
CONFIG_ESP_TASK_WDT_TIMEOUT_S=25
```
